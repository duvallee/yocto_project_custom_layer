## conf/distro/eglfs-raspberrypi.conf
```bitbake
#
# Distribution definition for eglfs-raspberrypi
#   by duvallee.lee, 2020-05-21
#


# DISTRO = "openstlinux"
# DISTRO_NAME = "ST OpenSTLinux (A Yocto Project Based Distro)"
# DISTRO_VERSION = "2.6-${@bb.utils.contains('OPENSTLINUX_RELEASE', 'snapshot', 'snapshot-${DATE}', '${OPENSTLINUX_RELEASE}', d)}"
# Don't include the DATE variable in the sstate package signatures
# DISTRO_VERSION[vardepsexclude] = "DATE"
# DISTRO_CODENAME = "thud"




# =========================================================================
# DISTRO features
# =========================================================================
DISTRO_FEATURES  = "alsa"
DISTRO_FEATURES += "argp"
DISTRO_FEATURES += "ext2"
DISTRO_FEATURES += "ext4"
DISTRO_FEATURES += "largefile"
DISTRO_FEATURES += "ipv4"
DISTRO_FEATURES += "ipv6"
DISTRO_FEATURES += "multiarch"
DISTRO_FEATURES += "wifi"
DISTRO_FEATURES += "nfs"
DISTRO_FEATURES += "usbgadget"
DISTRO_FEATURES += "usbhost"
DISTRO_FEATURES += "xattr"
DISTRO_FEATURES += "zeroconf"
DISTRO_FEATURES += "bluetooth"
DISTRO_FEATURES += "bluez5"
DISTRO_FEATURES += "opengl vulkan"

# add support of gstreamer
DISTRO_FEATURES_append = " gstreamer "

# add support of optee
DISTRO_FEATURES_append = " optee "

# add support of splashscreen
DISTRO_FEATURES_append = " splashscreen "

# add support of KDE (since OE thud version)
DISTRO_FEATURES_append = " kde "

# add support of systemd
DISTRO_FEATURES_append = " systemd "

# Disabling pulseaudio
#DISTRO_FEATURES_BACKFILL_CONSIDERED += "pulseaudio"
DISTRO_FEATURES_append = "pulseaudio"

# Disabling sysvinit
DISTRO_FEATURES_BACKFILL_CONSIDERED += "sysvinit"

VIRTUAL-RUNTIME_init_manager = "systemd"
VIRTUAL-RUNTIME_initscripts = "systemd-compat-units"
```

## conf/distro/raspberrypi-userland.conf
```bitbake
#
#
#
# -----------------------------------------------------------
DISTRO = "raspberrypi-userland"
DISTRO_NAME = "raspberrypi 4B Release Distro for userland"
DISTRO_VERSION = "1.0-dunfell"

DISTRO_CODENAME = "dunfell"
SDK_VENDOR = "-pokysdk"
SDK_VERSION = "${DISTRO_VERSION}"

# -----------------------------------------------------------
DISTRO_FEATURES_raspberrypi-wayland = "acl alsa argp bluetooth ext2 ipv4 ipv6 largefile usbgadget usbhost "
DISTRO_FEATURES_raspberrypi-wayland += "wifi xattr nfs zeroconf pci 3g nxc vfat largefile ptest multiarch "
DISTRO_FEATURES_raspberrypi-wayland += "opengl "
DISTRO_FEATURES_raspberrypi-wayland += "pulseaudio gobject-introspection-data ldconfig "
DISTRO_FEATURES_raspberrypi-wayland += "userland "
# DISTRO_FEATURES_raspberrypi-wayland += "sysvinit "
DISTRO_FEATURES_raspberrypi-wayland += "systemd "
DISTRO_FEATURES_raspberrypi-wayland_remove += "sysvinit "

# -----------------------------------------------------------
```

## conf/distro/raspberrypi-wayland.conf
```bitbake
#
#:
#
# -----------------------------------------------------------
DISTRO = "raspberrypi-wayland"
DISTRO_NAME = "raspberrypi 4B Release Distro for wayland"
DISTRO_VERSION = "1.0-dunfell"

DISTRO_CODENAME = "dunfell"
SDK_VENDOR = "-pokysdk"
SDK_VERSION = "${DISTRO_VERSION}"

# -----------------------------------------------------------
PREFERRED_VERSION_linux-raspberrypi = "5.10.%"

# -----------------------------------------------------------
KERNEL_MODULE_AUTOLOAD += "i2c-dev"
# -----------------------------------------------------------
BOOT_SPACE = "81920"

# -----------------------------------------------------------
# for 32 bit
# TARGET_FPU_remove = "${@bb.utils.contains('MACHINE', 'raspberrypi4-64', '', 'hard', d)}"
# TUNE_FEATURES_remove = "${@bb.utils.contains('MACHINE', 'raspberrypi4-64', '', 'vfp', d)}"
# TUNE_FEATURES_remove = "${@bb.utils.contains('MACHINE', 'raspberrypi4-64', '', 'vfpv4', d)}"

# -----------------------------------------------------------
MACHINE_FEATURES += "vc4graphics "

# -----------------------------------------------------------
DISTRO_FEATURES_raspberrypi-wayland = "acl alsa argp bluetooth ext2 ipv4 ipv6 largefile usbgadget usbhost "
DISTRO_FEATURES_raspberrypi-wayland += "wifi xattr nfs zeroconf pci 3g nxc vfat largefile ptest multiarch "
DISTRO_FEATURES_raspberrypi-wayland += "opengl vulkan "
DISTRO_FEATURES_raspberrypi-wayland += "pulseaudio gobject-introspection-data ldconfig "
DISTRO_FEATURES_raspberrypi-wayland += "wayland userland "
DISTRO_FEATURES_raspberrypi-wayland += "sysvinit "
# DISTRO_FEATURES_raspberrypi-wayland += "systemd "
# DISTRO_FEATURES_raspberrypi-wayland_remove += "sysvinit "

# -----------------------------------------------------------
```

## conf/distro/raspberrypi-weston.conf
```bitbake
#
# 
#
# -----------------------------------------------------------
DISTRO = "raspberrypi-weston"
DISTRO_NAME = "raspberrypi 4B Release Distro for weston"
DISTRO_VERSION = "1.0-dunfell"

DISTRO_CODENAME = "dunfell"
SDK_VENDOR = "-pokysdk"
SDK_VERSION = "${DISTRO_VERSION}"

# -----------------------------------------------------------
DISTRO_FEATURES_raspberrypi-weston += "systemd "
# DISTRO_FEATURES_raspberrypi-weston += "userland "
# DISTRO_FEATURES_raspberrypi-weston += "mesa "
DISTRO_FEATURES_raspberrypi-weston += "pam "
DISTRO_FEATURES_raspberrypi-weston += "opengl "
# DISTRO_FEATURES_raspberrypi-weston += "wayland "

# -----------------------------------------------------------
```

## conf/layer.conf
```bitbake
# We have a conf and classes directory, append to BBPATH
BBPATH .= ":${LAYERDIR}"

# We have a recipes directory containing .bb and .bbappend files, add to BBFILES
BBFILES += "${LAYERDIR}/recipes*/*/*.bb \
            ${LAYERDIR}/recipes*/*/*.bbappend"

BBFILE_COLLECTIONS += "raspberrypi_custom"
BBFILE_PATTERN_raspberrypi_custom := "^${LAYERDIR}/"
BBFILE_PRIORITY_raspberrypi_custom = "15"

LAYERSERIES_COMPAT_raspberrypi_custom = "dunfell"

DISTRO_FEATURE_raspberrypi_custom = "ros2"

# -----------------------------------------------------
IMAGE_FSTYPES += " tar.bz2 ext3 wic.bz2 wic.bmap rpi-sdimg "

# -----------------------------------------------------
```
